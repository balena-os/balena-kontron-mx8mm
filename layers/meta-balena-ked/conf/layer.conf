## layers/meta-balena-ked/conf/layer.conf
```bitbake
BBPATH .= ":${LAYERDIR}"

BBFILES += "${LAYERDIR}/recipes-*/*/*.bb \
            ${LAYERDIR}/recipes-*/*/*.bbappend"

BBFILE_COLLECTIONS += "balena-ked"
BBFILE_PATTERN_balena-ked := "^${LAYERDIR}/"
BBFILE_PRIORITY_balena-ked = "1337"

LAYERSERIES_COMPAT_balena-ked = "kirkstone"

# We use udev rules to create serial device aliases
# TODO NIELS: check if we need this
# SERIAL_CONSOLES = "115200;serial0"
```

## layers/meta-balena-kontron/conf/layer.conf
```bitbake
BBPATH .= ":${LAYERDIR}"

BBFILES += "${LAYERDIR}/recipes-*/*/*.bb \
            ${LAYERDIR}/recipes-*/*/*.bbappend"

BBFILE_COLLECTIONS += "balena-kontron"
BBFILE_PATTERN_balena-kontron := "^${LAYERDIR}/"
BBFILE_PRIORITY_balena-kontron = "1337"

LAYERSERIES_COMPAT_balena-kontron = "kirkstone"

BBMASK += "meta-ked-bsp/layers/meta-ked-imx/recipes-core/base-files/base-files_%.bbappend"

CORE_IMAGE_EXTRA_INSTALL:kontron-mx8mm += " kernel-devicetree "
CORE_IMAGE_EXTRA_INSTALL:kontron-mx8mm += " mtd-utils "

KERNEL_IMAGETYPE:kontron-mx8mm = "Image.gz"

FIRMWARE_COMPRESSION ?= "1"

HOSTTOOLS:remove = " git-lfs "
HOSTTOOLS:remove = " bison "
MACHINE_FEATURES:remove = "optee-os"
MACHINE_FEATURES:remove = "efi"

ROOTFS_POSTPROCESS_COMMAND:remove = "systemd_resolved_fix; "
```
